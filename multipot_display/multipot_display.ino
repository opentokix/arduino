#include <SPI.h>
#include <Wire.h>
#include <Adafruit_GFX.h>
#include <Adafruit_SSD1306.h>

#define GREY 0x7777
//#define SSD1306_128_64
Adafruit_SSD1306 display(128,64);


//Params 
#define nplogo_w 100
#define nplogo_h 50
const unsigned char nplogo [] PROGMEM = {
  0x00, 0x00, 0x00, 0x00, 0x00, 0x00, 0x00, 0x00, 0x00, 0x00, 0x00, 0x00, 0x00, 0x00, 0x00, 0x00, 
  0x00, 0x00, 0x00, 0x00, 0x00, 0x00, 0x00, 0x00, 0x00, 0x00, 0x00, 0x00, 0x00, 0x00, 0x00, 0x00, 
  0x00, 0x00, 0x00, 0x00, 0x00, 0x00, 0x00, 0x00, 0x00, 0x00, 0x00, 0x00, 0x00, 0x00, 0x00, 0x00, 
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  0x00, 0x00, 0x00, 0x00, 0x00, 0x00, 0x00, 0x00, 0x00, 0x00, 0x00, 0x00, 0x00, 0x00, 0x00, 0x00
};


const int relay1 = 4; 
const int relay2 = 5; 
const int relay3 = 6; 
const int relay4 = 7;
 
int pot1 = 0; 
int pot2 = 0; 
int pot3 = 0; 
int pot4 = 0; 
int sens = 0; 

const int Button = 9; 
int buttonState = 0; 

void setup() {
  pinMode(Button, INPUT_PULLUP);
  digitalWrite(Button, HIGH);
  pinMode(relay1, OUTPUT);
  pinMode(relay2, OUTPUT);
  pinMode(relay3, OUTPUT);
  pinMode(relay4, OUTPUT);
  
  // initialize with the I2C addr 0x3C
  display.begin(SSD1306_SWITCHCAPVCC, 0x3C);  
  display.clearDisplay();
  //Show logo 2s 
  display.drawBitmap(0,0,nplogo, 128, 64, WHITE);

  //display.drawPixel(10,10,WHITE);
  display.display();
  delay(2000);
  // Clear the buffer.
  display.clearDisplay();
  


  
  Serial.begin(9600);
  Serial.println(F("Initialize")); 

  pot1 = analogRead(A1);
  pot2 = analogRead(A2);
  pot3 = analogRead(A3);
  pot4 = analogRead(A0);
  sens = analogRead(A10);
  display.clearDisplay();
}

void clickRelay(int delay1, int  delay2, int delay3, int delay4) {
  unsigned long startTime = millis();
  bool a = false;
  bool b = false;
  bool c = false;  
  bool d = false; 
  
  while(1) {
    if (delay1 < (millis() - startTime)) {
      digitalWrite(relay1, HIGH); 
      a = true;
    }
    if (delay2 < (millis() - startTime)) {
      digitalWrite(relay2, HIGH); 
      b = true;
    } 
    if (delay3 < (millis() - startTime)) {
      digitalWrite(relay3, HIGH); 
      c = true;
    }
    if (delay4 < (millis() - startTime)) {
      digitalWrite(relay4, HIGH); 
      d = true;
    }
    
    if (a && b && c && d) {
      delay(2000); 
      digitalWrite(relay1, LOW); 
      digitalWrite(relay2, LOW); 
      digitalWrite(relay3, LOW);       
      digitalWrite(relay4, LOW); 
      break;
      }
  }
}

void loop() {
  // put your main code here, to run repeatedly:
  pot1 = analogRead(A1)*4;
  pot2 = analogRead(A2)*4;
  pot3 = analogRead(A3)*4;
  pot4 = analogRead(A0)*4;  
  sens = analogRead(A10)/100;
  
  display.setTextSize(0.5);
  display.setTextColor(WHITE, BLACK);
  display.setCursor(0,0);
  display.println("S1:" + getPadded4(pot1)+"ms");
  display.setCursor(0,14);
  display.println("S2:" + getPadded4(pot2)+"ms");
  display.setCursor(0,14*2);
  display.println("S3:" + getPadded4(pot3)+"ms");
  display.setCursor(0,14*3);
  display.println("S4:" + getPadded4(pot4)+"ms");
  display.setTextColor(WHITE, BLACK);
  display.setCursor(60,0);
  display.println("Sens: " + getPadded1(sens)); 

  display.display();
  if (digitalRead(Button) == 0) {clickRelay(pot1, pot2, pot3, pot4);}
}

String getPadded4(int num) {
  char buff[6];
  char padded[7];
  //sprintf function will convert the long to a string
  sprintf(buff, "%.4u", num); // buff will be "01238"
  padded[0] = buff[0];
  padded[1] = buff[1];
  padded[2] = buff[2];
  padded[3] = buff[3];
  padded[4] = buff[4];
  padded[5] = buff[5];
  padded[6] = '\0'; // The terminating NULL
  return String(padded);
}

String getPadded1(int num) {
  char buff[6];
  char padded[7];
  //sprintf function will convert the long to a string
  sprintf(buff, "%.2u", num); // buff will be "01238"
  padded[0] = buff[0];
  padded[1] = buff[1];
  padded[2] = buff[2];
  padded[3] = buff[3];
  padded[4] = buff[4];
  padded[5] = buff[5];
  padded[6] = '\0'; // The terminating NULL
  return String(padded);
}
